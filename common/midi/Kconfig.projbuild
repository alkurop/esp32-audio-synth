## common/midi/Kconfig.projbuild
```kconfig
menu "Metalbox MIDI Device Config"

config MIDI_COMPANY_NAME
    string "MIDI Company Name"
    default "Metalbox"
    help
      The manufacturer name for the USB MIDI device.

config MIDI_PRODUCT_NAME
    string "MIDI Product Name"
    default "Metalbox Synth"
    help
      The product name for the USB MIDI device.

config MIDI_DEVICE_ID
    string "MIDI Device ID (Serial Number)"
    default "0001"
    help
      The serial number string for the USB MIDI device.

endmenu
```

## esp32s3-synth-ui/components/ssd1306_display/Kconfig.projbuild
```kconfig
menu "Synth Menu"

config HUMAN_INT_OFFSET
    int "Human-integer display offset"
    default 1
    help
        Value to add to all raw integer parameters before displaying
        (e.g. set to 1 for 1-based MIDI channels).  Leave at 0 for
        zero-based display in development.

endmenu
```

## esp32s3-synth-ui/sdkconfig.defaults
```kconfig
CONFIG_IDF_TARGET="esp32s3"
CONFIG_CXX_EXCEPTIONS=y

#display ss1306
CONFIG_LV_USE_USER_DATA=y
CONFIG_LV_COLOR_DEPTH_1=y

CONFIG_LV_FONT_MONTSERRAT_10=y
CONFIG_LV_FONT_MONTSERRAT_12=y
CONFIG_LV_FONT_MONTSERRAT_14=y
CONFIG_LV_FONT_MONTSERRAT_16=y

# If you want 12 px to be the *default* font (i.e. LV_DEFAULT_FONT):
CONFIG_LV_FONT_DEFAULT_MONTSERRAT_14=y

CONFIG_LOG_DEFAULT_LEVEL_DEBUG=y
CONFIG_BOOTLOADER_LOG_LEVEL_NONE=y


# menu settings
CONFIG_HUMAN_INT_OFFSET=1

# increase nvs size with a custom partition
CONFIG_PARTITION_TABLE_CUSTOM=y
CONFIG_PARTITION_TABLE_CUSTOM_FILENAME="partitions.csv"
CONFIG_PARTITION_TABLE_FILENAME="partitions.csv"
CONFIG_PARTITION_TABLE_OFFSET=0x8000
```

## esp32s3-synth/sdkconfig.defaults
```kconfig
CONFIG_IDF_TARGET="esp32s3"


#CONFIG_LOG_DEFAULT_LEVEL_INFO=y
CONFIG_LOG_DEFAULT_LEVEL_NONE=y

CONFIG_BOOTLOADER_LOG_LEVEL_NONE=y

# increase processor speed
CONFIG_ESP32S2_DEFAULT_CPU_FREQ_MHZ=240
CONFIG_WIFI_ENABLED=n
CONFIG_BT_ENABLED=n
CONFIG_ESP_NETIF_ENABLED=n
CONFIG_I2C_ENABLE_SLAVE_DRIVER_VERSION_2=y

# increase partition size with a custom partition
CONFIG_PARTITION_TABLE_CUSTOM=y
CONFIG_PARTITION_TABLE_CUSTOM_FILENAME="partitions.csv"
CONFIG_PARTITION_TABLE_FILENAME="partitions.csv"
CONFIG_PARTITION_TABLE_OFFSET=0x8000
CONFIG_ESPTOOLPY_FLASHSIZE_4MB=y
```
